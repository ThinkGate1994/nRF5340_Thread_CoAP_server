## prj.conf
```kconfig
#
# Copyright (c) 2020 Nordic Semiconductor
#
# SPDX-License-Identifier: LicenseRef-Nordic-5-Clause
#

# nRF board library
CONFIG_DK_LIBRARY=y

# Enable OpenThread CoAP support API
CONFIG_OPENTHREAD_COAP=y

# Network shell
CONFIG_SHELL=y
CONFIG_OPENTHREAD_SHELL=y
CONFIG_SHELL_ARGC_MAX=26
CONFIG_SHELL_CMD_BUFF_SIZE=416

# Network sockets
CONFIG_NET_SOCKETS=y
CONFIG_NET_SOCKETS_POSIX_NAMES=y
CONFIG_NET_SOCKETS_POLL_MAX=4

# Same network Master Key for client and server
CONFIG_OPENTHREAD_NETWORKKEY="00:11:22:33:44:55:66:77:88:99:aa:bb:cc:dd:ee:ff"

# L2 OpenThread enabling
CONFIG_NET_L2_OPENTHREAD=y

# Generic networking options
CONFIG_NETWORKING=y

CONFIG_MBEDTLS_SHA1_C=n
CONFIG_FPU=y

CONFIG_COMMON_LIBC_MALLOC=n
CONFIG_LOG=y
CONFIG_COMPILER_FREESTANDING=n
CONFIG_FORTIFY_SOURCE_COMPILE_TIME=y
```

## src/main.c
```c
#include <zephyr/kernel.h>
#include <dk_buttons_and_leds.h>
#include <zephyr/logging/log.h>
#include <zephyr/net/openthread.h>
#include <openthread/thread.h>

#include "ot_coap_server.h"
#include "openthread.h"

LOG_MODULE_REGISTER(main_c, CONFIG_COAP_SERVER_LOG_LEVEL);

int main(void)
{
	int ret;

	LOG_INF("Start CoAP-server sample");

	ret = dk_leds_init();
	if (ret)
	{
		LOG_ERR("Could not initialize leds, err code: %d", ret);
		goto end;
	}

	addIPv6Address();
	openthread_init();

	// Initialize CoAP server settings
	struct ot_coap_server_settings coap_settings = {
		.coap_uri_path = "data",
		.coap_port = 5683, // #default 5683, You can replace it with your desired port
	};

	ret = ot_coap_server_init(&coap_settings);
	if (ret)
	{
		LOG_ERR("Could not initialize OpenThread CoAP");
		goto end;
	}

	char payload_buffer[PAYLOAD_SIZE];
	uint16_t payload_length;
	while (1)
	{
		int result = ot_coap_server_get_payload(payload_buffer, &payload_length);

		if (result == 0)
		{
			// printk("CoAP Payload: %s\n", payload_buffer);
		}
		else
		{
			printk("Failed to get CoAP payload\n");
		}
		k_msleep(1000);
	}

end:

	return 0;
}
```

## src/openthread.c
```c
#include <zephyr/kernel.h>
#include <zephyr/logging/log.h>
#include <zephyr/net/socket.h>
#include <zephyr/net/openthread.h>
#include <openthread/thread.h>
#include <dk_buttons_and_leds.h>

#include "openthread.h"

LOG_MODULE_REGISTER(openthread);

#define OT_CONNECTION_LED DK_LED1

static void on_thread_state_changed(otChangedFlags flags, struct openthread_context *ot_context, void *user_data)
{
	if (flags & OT_CHANGED_THREAD_ROLE)
	{
		switch (otThreadGetDeviceRole(ot_context->instance))
		{
		case OT_DEVICE_ROLE_CHILD:
			LOG_INF("thread child\n");
		case OT_DEVICE_ROLE_ROUTER:
			LOG_INF("thread router\n");
		case OT_DEVICE_ROLE_LEADER:
			LOG_INF("thread leader\n");
			dk_set_led_on(OT_CONNECTION_LED);
			break;
		case OT_DEVICE_ROLE_DISABLED:
			LOG_INF("thread role disabled\n");
		case OT_DEVICE_ROLE_DETACHED:
			LOG_INF("thread role detached\n");
		default:
			dk_set_led_off(OT_CONNECTION_LED);
			break;
		}
	}
}

static struct openthread_state_changed_cb ot_state_chaged_cb = {.state_changed_cb = on_thread_state_changed};

void openthread_init()
{
	openthread_state_changed_cb_register(openthread_get_default_context(), &ot_state_chaged_cb);
	openthread_start(openthread_get_default_context());
}
```

## src/openthread.h
```c
#ifndef _OPENTHREAD_SERVER_H
#define _OPENTHREAD_SERVER_H

void openthread_init();

#endif
```

## src/ot_coap_server.c
```c
#include <zephyr/logging/log.h>
#include <zephyr/net/net_pkt.h>
#include <zephyr/net/net_l2.h>
#include <zephyr/net/openthread.h>
#include <openthread/coap.h>
#include <openthread/ip6.h>
#include <openthread/message.h>
#include <openthread/thread.h>

#include "ot_coap_server.h"

LOG_MODULE_REGISTER(ot_coap_server);

struct server_context
{
	struct otInstance *ot;
};

static struct server_context srv_context = {
	.ot = NULL};

static otCoapResource coap_resource = {
	.mUriPath = NULL,
	.mHandler = NULL,
	.mContext = NULL,
	.mNext = NULL,
};

static struct ot_coap_server_get_payload payload = {
	.buffer = "",
	.length = 0,
};

static otError storedata_response_send(otMessage *request_message, const otMessageInfo *message_info);

static void CoAP_request_handler(void *context, otMessage *message, const otMessageInfo *message_info)
{
	printk("in\n");

	ARG_UNUSED(context);

	if ((otCoapMessageGetType(message) != OT_COAP_TYPE_CONFIRMABLE) && (otCoapMessageGetType(message) != OT_COAP_TYPE_NON_CONFIRMABLE))
	{
		LOG_ERR("CoAP handler - Unexpected type of message");
		goto end;
	}

	if ((otCoapMessageGetCode(message) != OT_COAP_CODE_PUT) && (otCoapMessageGetCode(message) != OT_COAP_CODE_POST))
	{
		LOG_ERR("CoAP handler - Unexpected CoAP code");
		goto end;
	}

	payload.length = otMessageRead(message, otMessageGetOffset(message), payload.buffer, PAYLOAD_SIZE - 1);

	if (payload.length > 0)
	{
		payload.buffer[payload.length] = '\0';
		LOG_INF("CoAP message: %s , %d", payload.buffer, payload.length);
	}
	else
	{
		LOG_ERR("Error reading payload");
	}

	if (otCoapMessageGetType(message) == OT_COAP_TYPE_CONFIRMABLE)
	{
		storedata_response_send(message, message_info);
	}
end:
	return;
}

int ot_coap_server_get_payload(char *buffer, uint16_t *length)
{
	if (buffer == NULL || length == NULL)
	{
		return -1;
	}

	memcpy(buffer, payload.buffer, PAYLOAD_SIZE);
	*length = payload.length;

	return 0;
}

static otError storedata_response_send(otMessage *request_message, const otMessageInfo *message_info)
{
	otError error = OT_ERROR_NO_BUFS;
	otMessage *response;
	otInstance *p_instance = openthread_get_default_instance();
	const char *payload;
	// uint16_t payload_size;

	response = otCoapNewMessage(p_instance, NULL);
	if (response == NULL)
	{
		goto end;
	}

	otCoapMessageInit(response, OT_COAP_TYPE_NON_CONFIRMABLE,
					  OT_COAP_CODE_CONTENT);

	error = otCoapMessageSetToken(
		response, otCoapMessageGetToken(request_message),
		otCoapMessageGetTokenLength(request_message));
	if (error != OT_ERROR_NONE)
	{
		goto end;
	}

	error = otCoapMessageSetPayloadMarker(response);
	if (error != OT_ERROR_NONE)
	{
		goto end;
	}

	payload = "Test response payload";

	error = otMessageAppend(response, payload, strlen(payload));
	if (error != OT_ERROR_NONE)
	{
		goto end;
	}

	error = otCoapSendResponse(p_instance, response, message_info);

	// LOG_HEXDUMP_INF(payload, payload_size, "Sent provisioning response:");

end:
	if (error != OT_ERROR_NONE && response != NULL)
	{
		otMessageFree(response);
	}

	return error;
}

static void CoAP_default_handler(void *context, otMessage *message, const otMessageInfo *message_info)
{
	ARG_UNUSED(context);
	ARG_UNUSED(message);
	ARG_UNUSED(message_info);

	LOG_INF("Received CoAP message that does not match any request or resource");
}

void addIPv6Address(void)
{
	otInstance *myInstance = openthread_get_default_instance();
	otNetifAddress aAddress;
	const otMeshLocalPrefix *ml_prefix = otThreadGetMeshLocalPrefix(myInstance);
	uint8_t interfaceID[8] = {0x00, 0x00, 0x00, 0xff, 0x00, 0x00, 0x00, 0x01};

	memcpy(&aAddress.mAddress.mFields.m8[0], ml_prefix, 8);
	memcpy(&aAddress.mAddress.mFields.m8[8], interfaceID, 8);

	otError error = otIp6AddUnicastAddress(myInstance, &aAddress);

	if (error != OT_ERROR_NONE)
	{
		printk("addIPv6Address error: %d\n", error);
	}
}

int ot_coap_server_init(struct ot_coap_server_settings *settings)
{
	otError error;

	srv_context.ot = openthread_get_default_instance();
	if (!srv_context.ot)
	{
		LOG_ERR("There is no valid OpenThread instance");
		error = OT_ERROR_FAILED;
		goto end;
	}

	coap_resource.mUriPath = settings->coap_uri_path;
	coap_resource.mHandler = CoAP_request_handler;
	coap_resource.mContext = srv_context.ot;

	otCoapSetDefaultHandler(srv_context.ot, CoAP_default_handler, NULL);
	otCoapAddResource(srv_context.ot, &coap_resource);

	error = otCoapStart(srv_context.ot, settings->coap_port);
	if (error != OT_ERROR_NONE)
	{
		LOG_ERR("Failed to start OT CoAP. Error: %d", error);
		goto end;
	}

end:
	return error == OT_ERROR_NONE ? 0 : 1;
}
```

## src/ot_coap_server.h
```c
#ifndef __OT_COAP_SERVER_H__
#define __OT_COAP_SERVER_H__

#include <stdint.h>

#define PAYLOAD_SIZE 256

struct ot_coap_server_get_payload
{
    char buffer[PAYLOAD_SIZE];
    uint16_t length;
};

struct ot_coap_server_settings
{
    const char *coap_uri_path;
    uint16_t coap_port;
};

int ot_coap_server_init(struct ot_coap_server_settings *settings);
int ot_coap_server_get_payload(char *buffer, uint16_t *length);

#endif
```
